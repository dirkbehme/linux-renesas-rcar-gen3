## Documentation/devicetree/bindings/misc/renesas,rcar-rst.txt
```
Renesas RCar r8a779x reset module
-----------------------------------------------------
This binding defines the reset module found on Renesas RCar r8a779x
SoCs. The reset module contains several reset related registers,
the meaning of them is implementation dependent.

Required properties:
- compatible : "renesas,rcar-rst"
- reg : Location and size of the reset module

Example:
	reset-controller@e6160000 {
		compatible = "renesas,rcar-rst";
		reg = <0 0xe6160000 0 0x200>;
	};
```

## drivers/misc/boot-mode-reg/Kconfig
```kconfig
#
# Boot Mode Register Drivers
#

config BOOT_MODE_REG_CORE
	tristate "Boot Mode Register Core Driver"
	default n
	depends on ARCH_SHMOBILE || ARCH_RENESAS || COMPILE_TEST
	help
	  Say Y here to allow support for drivers to read boot mode
	  registers and make the value available to other subsystems.

config BOOT_MODE_REG_RCAR
	tristate "Boot Mode Register Driver for Renesas R-Car SoCs"
	default n
	select BOOT_MODE_REG_CORE
	help
	  Say Y here to allow support for reading the boot mode register
	  on Renesas R-Car SoCs.
```
